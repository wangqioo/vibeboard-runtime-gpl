## firmware/vibeboard_runtime/sdkconfig.defaults
```kconfig
CONFIG_IDF_TARGET="esp32s3"
CONFIG_ESPTOOLPY_FLASHSIZE_16MB=y
CONFIG_PARTITION_TABLE_CUSTOM=y
CONFIG_PARTITION_TABLE_CUSTOM_FILENAME="partitions.csv"
CONFIG_SPIRAM=y
CONFIG_SPIRAM_MODE_OCT=y
CONFIG_SPIRAM_SPEED_80M=y
CONFIG_SPIRAM_MALLOC_ALWAYSINTERNAL=2048
CONFIG_SPIRAM_MALLOC_RESERVE_INTERNAL=0
CONFIG_SPIRAM_TRY_ALLOCATE_WIFI_LWIP=y
CONFIG_NVS_ALLOCATE_CACHE_IN_SPIRAM=y
# Runtime reads WiFi credentials from SD and can pay a full PHY calibration
# at boot, so keep WiFi startup independent of NVS internal-RAM pressure.
# CONFIG_ESP_WIFI_NVS_ENABLED is not set
# CONFIG_ESP_PHY_CALIBRATION_AND_DATA_STORAGE is not set
# CONFIG_ESP_PHY_RF_CAL_PARTIAL is not set
CONFIG_ESP_PHY_RF_CAL_FULL=y
CONFIG_ESP_DEFAULT_CPU_FREQ_MHZ_240=y
CONFIG_ESP32S3_INSTRUCTION_CACHE_32KB=y
CONFIG_ESP32S3_DATA_CACHE_64KB=y
CONFIG_ESP32S3_DATA_CACHE_LINE_64B=y
CONFIG_ESP_MAIN_TASK_STACK_SIZE=8192
CONFIG_LV_COLOR_16_SWAP=y
CONFIG_LV_USE_BMP=y
CONFIG_LV_USE_GIF=y
CONFIG_LV_USE_PNG=y
CONFIG_LV_FONT_SIMSUN_16_CJK=y
CONFIG_LV_FONT_DEFAULT_SIMSUN_16_CJK=y
CONFIG_LV_MEM_CUSTOM=y
CONFIG_LV_MEM_CUSTOM_INCLUDE="lvgl_runtime_alloc.h"
CONFIG_GC2145_SUPPORT=y
CONFIG_GC0308_SUPPORT=y
CONFIG_SCCB_HARDWARE_I2C_DRIVER_LEGACY=y
# CONFIG_SCCB_HARDWARE_I2C_DRIVER_NEW is not set
CONFIG_CAMERA_DMA_BUFFER_SIZE_MAX=8192
CONFIG_CAMERA_PSRAM_DMA=y
CONFIG_FATFS_LFN_STACK=y
# Keep FATFS file buffers internal so SDMMC reads can use DMA-aligned memory
# while Lua/HTTP task stacks continue to absorb larger allocations in PSRAM.
# CONFIG_FATFS_ALLOC_PREFER_EXTRAM is not set
# Keep Runtime WiFi reachable after display, SD, registry, and native-module
# startup by moving eligible WiFi/LwIP allocations out of internal RAM.
CONFIG_ESP_WIFI_STATIC_RX_BUFFER_NUM=6
CONFIG_ESP_WIFI_DYNAMIC_RX_BUFFER_NUM=8
CONFIG_ESP_WIFI_STATIC_TX_BUFFER_NUM=8
CONFIG_ESP_WIFI_MGMT_SBUF_NUM=16
# CONFIG_ESP_WIFI_ENABLE_WPA3_SAE is not set
# CONFIG_ESP_WIFI_ENABLE_SAE_PK is not set
# CONFIG_ESP_WIFI_ENABLE_SAE_H2E is not set
# CONFIG_ESP_WIFI_SOFTAP_SAE_SUPPORT is not set
# CONFIG_ESP_WIFI_ENABLE_WPA3_OWE_STA is not set
CONFIG_LWIP_MAX_SOCKETS=10
CONFIG_LWIP_MAX_ACTIVE_TCP=8
CONFIG_LWIP_MAX_LISTENING_TCP=8
CONFIG_LWIP_TCPIP_RECVMBOX_SIZE=16
CONFIG_LWIP_TCP_SND_BUF_DEFAULT=2920
CONFIG_LWIP_TCP_WND_DEFAULT=2920
CONFIG_LWIP_MAX_UDP_PCBS=8
CONFIG_LWIP_MAX_RAW_PCBS=4
```
